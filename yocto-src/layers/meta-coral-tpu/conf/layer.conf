## yocto-src/layers/meta-coral-tpu/conf/layer.conf
```bitbake
# We have a conf and classes directory, add to BBPATH
BBPATH .= ":${LAYERDIR}"

# We have recipes-* directories, add to BBFILES
BBFILES += "${LAYERDIR}/recipes-*/*/*.bb \
            ${LAYERDIR}/recipes-*/*/*.bbappend"

BBFILE_COLLECTIONS += "meta-coral-tpu"
BBFILE_PATTERN_meta-coral-tpu = "^${LAYERDIR}/"
BBFILE_PRIORITY_meta-coral-tpu = "10"

LAYERDEPENDS_meta-coral-tpu = "core"
LAYERSERIES_COMPAT_meta-coral-tpu = "dunfell"
```
